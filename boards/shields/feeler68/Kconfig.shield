## boards/shields/feeler68/Kconfig.shield
```kconfig
# Copyright (c) 2020 The ZMK Contributors
# SPDX-License-Identifier: MIT

config SHIELD_FEELER68
    def_bool $(shields_list_contains,feeler68)
```
